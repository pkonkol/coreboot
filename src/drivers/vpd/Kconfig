## src/drivers/vpd/Kconfig
```kconfig
##
## This file is part of the coreboot project.
##
## This program is free software; you can redistribute it and/or modify
## it under the terms of the GNU General Public License as published by
## the Free Software Foundation; version 2 of the License.
##
## This program is distributed in the hope that it will be useful,
## but WITHOUT ANY WARRANTY; without even the implied warranty of
## MERCHANTABILITY or FITNESS FOR A PARTICULAR PURPOSE.  See the
## GNU General Public License for more details.
##

config VPD
	bool "Support for Vital Product Data tables"
	default n
	help
	  Enable support for flash based vital product data.

config VPD_CONFIG_FILE
	string "Path to the VPD key-value pair list"
	depends on VPD
	help
	  Provides a list of key-value pair to format the VPD regions at build
	  time.
```
